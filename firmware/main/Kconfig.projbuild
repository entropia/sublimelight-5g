## firmware/main/Kconfig.projbuild
```kconfig
menu "SublimeLight-5G configuration"

config SL5G_WIFI_SSID
    string "WiFi SSID"
    default "entropia-iot"
    help
	SSID (network name) to connect to.

config SL5G_WIFI_PASSWORD
    string "WiFi Password"
    help
	WiFi password (WPA or WPA2) to use.

config SL5G_DEFAULT_DEVICE_NAME
    string "Default device name"
    default "sl5g99"
    help
        The default name for the device. The device name is used to build the MQTT prefix.

config SL5G_DEFAULT_MQTT_BROKER_URI
    string "Default MQTT broker URI"
    default "mqtt://mqtt.club.entropia.de"
    help
        Default URI of the MQTT broker to listen to. Be sure to inlcude the mqtt:// protocol specifier.

config SL5G_PWM_FREQ
    int "PWM Frequency"
    default 6000
    help
        Frequency to use for the main LED's PWM in Hertz.
        The hardware drivers specify a maximum of 1000 Hz, but it seems safe to go higher.

config SL5G_FALLBACK_WARM_INTENSITY
    int "Warm white fallback intensity"
    default 2000
    help
        Intensity for the warm white channel in fallback mode.

config SL5G_FALLBACK_COLD_INTENSITY
    int "Cold white fallback intensity"
    default 2000
    help
        Intensity for the cold white channel in fallback mode.

endmenu
```
